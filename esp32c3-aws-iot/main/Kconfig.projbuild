## esp32c3-aws-iot/main/Kconfig.projbuild
```kconfig
menu "AWS IoT App Configuration"

config APP_WIFI_SSID
    string "WiFi SSID"
    default "FX0"
    // default "YOUR_WIFI"

config APP_WIFI_PASSWORD
    string "WiFi Password"
    default "Panchok4749311716!"
    // default "YOUR_WIFI_PASS"
config APP_AWS_ENDPOINT
    string "AWS IoT endpoint"
    default "xxxxxxxxxxxxx-ats.iot.us-west-2.amazonaws.com"

config APP_AWS_CLIENT_ID
    string "MQTT client ID"
    default "esp32c3-01"

config APP_MQTT_PORT
    int "MQTT TLS port"
    default 8883

config APP_MQTT_PUB_TOPIC
    string "Publish topic"
    default "esp32c3/test"

config APP_MQTT_SUB_TOPIC
    string "Subscribe topic"
    default "esp32c3/test"

config APP_PUBLISH_INTERVAL_MS
    int "Publish interval (ms)"
    default 5000

config APP_LED_SUB_TOPIC
    string "LED command subscribe topic"
    default "esp32c3/awsiot1/led/set"

config APP_LED_STATE_TOPIC
    string "LED state publish topic"
    default "esp32c3/awsiot1/led/state"

endmenu
```

## esp32c3-aws-iot/sdkconfig.defaults
```kconfig
CONFIG_ESP_WIFI_ENABLED=y
CONFIG_MQTT_PROTOCOL_311=y
CONFIG_MQTT_TRANSPORT_SSL=y
CONFIG_ESP_TLS_USING_MBEDTLS=y
CONFIG_ESP_MAIN_TASK_STACK_SIZE=8192
```
